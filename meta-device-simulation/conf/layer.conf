## meta-device-simulation/conf/layer.conf
```bitbake
BBPATH .= ":${LAYERDIR}"

BBFILES += "${LAYERDIR}/recipes-*/*/*.bbappend"

BBFILE_COLLECTIONS += "device-simulation"
BBFILE_PATTERN_device-simulation := "^${LAYERDIR}/"
BBFILE_PRIORITY_device-simulation = "10"

LAYERDEPENDS_device-simulation = "core raspberrypi"
LAYERSERIES_COMPAT_device-simulation = "kirkstone"
```
